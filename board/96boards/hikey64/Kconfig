## board/96boards/hikey64/Kconfig
```kconfig
if TARGET_96BOARDS_HIKEY

config SYS_BOARD
	default "hikey64"

config SYS_VENDOR
	default "96boards"

config SYS_CONFIG_NAME
	default "hikey_aemv8a"

endif
```

## configs/hikey_aemv8a_defconfig
```kconfig
# 96boards HiKey
CONFIG_ARM=y
CONFIG_TARGET_96BOARDS_HIKEY=y
CONFIG_DEFAULT_DEVICE_TREE="hikey"
CONFIG_SHOW_BOOT_PROGRESS=y
```
